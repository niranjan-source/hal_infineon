# psc3_p8 register map
Vendor: Infineon Technologies; Series: PSC3_P8; File version: 1.0
CPU: CM33 r0p1, little endian, MPU, FPU, VTOR, 3 interrupt priority bits
Registers are 32-bit, read-write, reset 0x0 unless marked. A register's access mark holds for its fields unless they carry their own. Offsets are from the block's base; lines under a group give offsets from that group; [hi:lo] are bit positions; {n}, {i} and the like mark numbered series; 'fields as' and 'values as' point back to an identical list; <NAME> marks a mode.

## Memory map
0x42000000 PERI size 0x10000 — Peripheral interconnect
0x42020000 PPC size 0x10000 — Peripheral Protection Controller
0x42040000 PERI_PCLK size 0x20000 — Peripheral PCLK groups
0x42100000 RAMC_PPU0 size 0x1000 — Power Policy Unit Registers for System RAM
0x42101000 RAMC_PPU1 size 0x1000
0x42103000 ICACHE0 size 0x1000 — CM33_0/1 CA APB interface
0x42105000 CPUSS_PPU size 0x1000 — Power Policy Unit Registers for CPUSS
0x42110000 RAMC0 size 0x10000 — RAMC0/1/2
0x42120000 RAMC1 size 0x10000
0x42140000 PROMC size 0x10000 — Patchable ROM Controller
0x42150000 FLASHC size 0x10000
0x42160000 MXCM33 size 0x10000 — MXCM33-0/1
0x42180000 DW0 size 0x10000 — DW-0/1
0x421C0000 CPUSS size 0x4000 — SYSCPUSS registers
0x421C4000 MS_CTL_2_1 size 0x4000 — Master control registers
0x421C8000 CPUSS_SL_CTL size 0x10 — SYSCPUSS Internal slave control registers
0x421D0000 IPC size 0x10000
0x421E0000 FAULT size 0x10000 — Fault structures
0x42200000 SRSS size 0x10000 — SRSS Core Registers
0x42210000 PWRMODE size 0x10000 — SRSS Power Mode Control Registers
0x42220000 BACKUP size 0x10000 — SRSS Backup Registers
0x42230000 CRYPTOLITE size 0x10000
0x42240000 MXWOUND size 0x1000 — 0
0x42250000 DEBUG600 size 0x100
0x42260000 SVGS size 0x100 — SVGS Registers
0x42270000 MXAES size 0x2000
0x42400000 HSIOM size 0x4000 — IO Matrix (IOM)
0x42410000 GPIO size 0x10000 — IO port control/configuration
0x42430000 LPCOMP size 0x10000 — Low Power Comparators
0x42500000 TCPWM0 size 0x100000 — S40 Timer/Counter/PWM
0x42610000 EFUSE size 0x200 — EFUSE MXS40 registers
0x42800000 CANFD0 size 0x20000 — CAN Controller
0x42820000 SCB0 size 0x10000 — Serial Communications Block (SPI/UART/I2C)
0x42840000 SCB1 size 0x10000
0x42850000 SCB2 size 0x10000
0x42860000 SCB3 size 0x10000
0x42870000 SCB4 size 0x10000
0x43000000 PPCA_CNFG size 0x1000
0x43004000 PPCA_EPU size 0x1000
0x43060000 PPCA_IPC size 0x10000 — IPC
0x43080000 PPCA_CPUSS_CNFG size 0x80000
0x43100000 PPCA_TCPWM0 size 0x100000 — S40 Timer/Counter/PWM
0x43200000 PPCA_TCPWM1 size 0x100000
0x43300000 PPCA_TCPWM2 size 0x100000
0x43400000 PPCA_TCPWM3 size 0x100000
0x43500000 PPCA_HWFILT3P3Z_SS_0 size 0x1000
0x43510000 PPCA_HWFILT3P3Z_SS_1 size 0x1000
0x43520000 PPCA_ADCM size 0x1000
0x43530000 PPCA_CLB size 0x8000
0x43540000 PPCA_MXCORDIC0 size 0x10000
0x43550000 PPCA_MXCORDIC1 size 0x10000
0x43580000 PPCA_ATOPSS_ADC_GRP0 size 0x2000
0x43582000 PPCA_ATOPSS_ADC_GRP1 size 0x2000
0x43584000 PPCA_ATOPSS_ADC_GRP2 size 0x2000
0x43586000 PPCA_ATOPSS_ADC_GRP3 size 0x2000
0x43588000 PPCA_ATOPSS_DCSG_GRP0 size 0x2000
0x4358A000 PPCA_ATOPSS_DCSG_GRP1 size 0x2000
0x43800000 SCB5 size 0x10000
0x43810000 SCB6 size 0x10000

## Interrupts
{n} ioss_interrupts_gpio_{n} (CPUSS) (n=0..9) — GPIO Port Interrupt #{n}
{n+10} ioss_interrupts_sec_gpio_{n} (CPUSS) (n=0..9) — GPIO Port Secure Interrupt #{n}
20 ioss_interrupt_vdd (CPUSS) — GPIO Supply Detect Interrupt
21 ioss_interrupt_gpio (CPUSS) — GPIO All Ports - Interrupts
22 ioss_interrupt_sec_gpio (CPUSS) — GPIO All Ports - Secure Interrupts
23 scb_0_interrupt (CPUSS) — Serial Communication Block #0 (DeepSleep capable)
24 srss_interrupt_mcwdt_0 (CPUSS) — Multi Counter Watchdog Timer interrupt
25 srss_interrupt_backup (CPUSS) — Backup domain interrupt
26 cpuss_interrupts_ipc_dpslp_0 (CPUSS) — cpuss Inter Process Communication Interrupt #0
27 cpuss_interrupts_ipc_dpslp_1 (CPUSS) — cpuss Inter Process Communication Interrupt #1
28 cpuss_interrupts_ipc_dpslp_2 (CPUSS) — cpuss Inter Process Communication Interrupt #2
29 cpuss_interrupts_ipc_dpslp_3 (CPUSS) — cpuss Inter Process Communication Interrupt #3
30 srss_interrupt_wdt (CPUSS) — Interrupt from WDT
31 lpcomp_interrupt (CPUSS) — LPCOMP
32 srss_interrupt (CPUSS) — Other combined Interrupts for srss (LVD and CLKCAL, CLKCAL only supported in Active mode)
33 scb_1_interrupt (CPUSS) — Serial Communication Block #1
34 scb_2_interrupt (CPUSS) — Serial Communication Block #2
35 scb_3_interrupt (CPUSS) — Serial Communication Block #3
36 scb_4_interrupt (CPUSS) — Serial Communication Block #4
37 scb_5_interrupt (CPUSS) — Serial Communication Block #5
38 scb_6_interrupt (CPUSS) — Serial Communication Block #5
39 cpuss_interrupt_fm_cbus (CPUSS) — FLASH Macro interrupt
{n+40} cpuss_interrupts_dw0_{n} (CPUSS) (n=0..15) — cpuss DataWire #0, Channel #{n}
56 cpuss_interrupt_ppu_sramc0 (CPUSS) — PPU SRAM0
57 cpuss_interrupt_ppu_sramc1 (CPUSS) — PPU SRAM1
58 cpuss_interrupt_cm33_0_fp (CPUSS) — CM33 0 Floating Point Interrupt
59 cpuss_interrupts_cm33_0_cti_0 (CPUSS) — CM33-0 CTI interrupt outputs
60 cpuss_interrupts_cm33_0_cti_1 (CPUSS) — CM33-1 CTI interrupt outputs
61 cpuss_interrupts_fault_0 (CPUSS) — cpuss Faults interrupt
62 cpuss_interrupt_ppu_cpuss (CPUSS) — cpuss PPU Interrupt
63 cpuss_interrupt_msc (CPUSS) — cpuss Master Security Controller Interrupt
64 tcpwm_0_interrupts_0 (CPUSS) — TCPWM #0, Counter #0
65 tcpwm_0_interrupts_1 (CPUSS) — TCPWM #0, Counter #1
66 tcpwm_0_interrupts_256 (CPUSS) — TCPWM #0, Counter #256
67 tcpwm_0_interrupts_257 (CPUSS) — TCPWM #0, Counter #257
68 srss_interrupt_main_ppu (CPUSS) — SRSS Main PPU Interrupt
69 cryptolite_interrupt_error (CPUSS) — Crypto Interrupt
70 cryptolite_interrupt_trng (CPUSS) — TRNG interrupt
71 canfd_0_interrupts0_0 (CPUSS) — CAN #0, Interrupt #0, Channel #0
72 canfd_0_interrupts1_0 (CPUSS) — CAN #0, Interrupt #1, Channel #0
73 canfd_0_interrupts0_1 (CPUSS) — CAN #0, Interrupt #0, Channel #1
74 canfd_0_interrupts1_1 (CPUSS) — CAN #0, Interrupt #1, Channel #1
75 canfd_0_interrupt0 (CPUSS) — Can #0, Consolidated interrupt #0
76 canfd_0_interrupt1 (CPUSS) — Can #0, Consolidated interrupt #1
77 ppca_ppu_0 (CPUSS) — PPCA interrupt #0
78 ppca_ppu_1 (CPUSS) — PPCA interrupt #1
79 ppca_ppu_2 (CPUSS) — PPCA interrupt #2
80 ppca_ppu_3 (CPUSS) — PPCA interrupt #3
81 ppca_ppu_4 (CPUSS) — PPCA interrupt #4
{n+82} ppca_epu_{n} (CPUSS) (n=0..7) — PPCA interrupt #{n+5}
90 ppca_pwm_0_grp_0_cnt_0 (CPUSS) — PPCA interrupt #13
91 ppca_pwm_0_grp_0_cnt_1 (CPUSS) — PPCA interrupt #14
92 ppca_pwm_0_grp_0_cnt_2 (CPUSS) — PPCA interrupt #15
93 ppca_pwm_0_grp_0_cnt_3 (CPUSS) — PPCA interrupt #16
94 ppca_pwm_0_grp_1_cnt_0 (CPUSS) — PPCA interrupt #17
95 ppca_pwm_0_grp_1_cnt_1 (CPUSS) — PPCA interrupt #18
96 ppca_pwm_0_grp_1_cnt_2 (CPUSS) — PPCA interrupt #19
97 ppca_pwm_0_grp_1_cnt_3 (CPUSS) — PPCA interrupt #20
98 ppca_pwm_0_grp_2_cnt_0 (CPUSS) — PPCA interrupt #21
99 ppca_pwm_0_grp_2_cnt_1 (CPUSS) — PPCA interrupt #22
100 ppca_pwm_0_grp_2_cnt_2 (CPUSS) — PPCA interrupt #23
101 ppca_pwm_0_grp_2_cnt_3 (CPUSS) — PPCA interrupt #24
102 ppca_pwm_1_grp_0_cnt_0 (CPUSS) — PPCA interrupt #25
103 ppca_pwm_1_grp_0_cnt_1 (CPUSS) — PPCA interrupt #26
104 ppca_pwm_1_grp_1_cnt_0 (CPUSS) — PPCA interrupt #27
105 ppca_pwm_1_grp_1_cnt_1 (CPUSS) — PPCA interrupt #28
106 ppca_pwm_1_grp_2_cnt_0 (CPUSS) — PPCA interrupt #29
107 ppca_pwm_1_grp_2_cnt_1 (CPUSS) — PPCA interrupt #30
108 ppca_pwm_1_grp_2_cnt_2 (CPUSS) — PPCA interrupt #31
109 ppca_pwm_1_grp_2_cnt_3 (CPUSS) — PPCA interrupt #32
110 ppca_pwm_2_grp_0_cnt_0 (CPUSS) — PPCA interrupt #33
111 ppca_pwm_2_grp_0_cnt_1 (CPUSS) — PPCA interrupt #34
112 ppca_pwm_2_grp_0_cnt_2 (CPUSS) — PPCA interrupt #35
113 ppca_pwm_2_grp_0_cnt_3 (CPUSS) — PPCA interrupt #36
114 ppca_pwm_3_grp_0_cnt_0 (CPUSS) — PPCA interrupt #37
115 ppca_pwm_3_grp_0_cnt_1 (CPUSS) — PPCA interrupt #38
116 ppca_clb (CPUSS) — PPCA interrupt #39
117 ppca_atop_0 (CPUSS) — PPCA interrupt #40
118 ppca_atop_1 (CPUSS) — PPCA interrupt #41
119 ppca_atop_2 (CPUSS) — PPCA interrupt #42
120 ppca_atop_3 (CPUSS) — PPCA interrupt #43
121 ppca_cordic_0 (CPUSS) — PPCA interrupt #44
122 ppca_cordic_1 (CPUSS) — PPCA interrupt #45
123 ppca_cnfg_rdy_for_dslp (CPUSS) — PPCA interrupt #46
124 ppca_ipc_0 (CPUSS) — PPCA interrupt #47
125 ppca_ipc_1 (CPUSS) — PPCA interrupt #48
126 ppca_ipc_2 (CPUSS) — PPCA interrupt #49
127 ppca_ipc_3 (CPUSS) — PPCA interrupt #50
128 ppca_pwm_0_motif_0 (CPUSS) — PPCA interrupt #51
129 ppca_pwm_0_motif_1 (CPUSS) — PPCA interrupt #52
130 ppca_pwm_1_motif_0 (CPUSS) — PPCA interrupt #53
131 ppca_pwm_1_motif_1 (CPUSS) — PPCA interrupt #54
132 ppca_cpu0_cti_0 (CPUSS) — PPCA interrupt #55
133 ppca_cpu0_cti_1 (CPUSS) — PPCA interrupt #56
134 ppca_cpu1_cti_0 (CPUSS) — PPCA interrupt #57
135 ppca_cpu1_cti_1 (CPUSS) — PPCA interrupt #58
136 ppca_cpu0_fp (CPUSS) — PPCA interrupt #59
137 ppca_cpu1_fp (CPUSS) — PPCA interrupt #60
138 ppca_irq_ppca_61 (CPUSS) — PPCA interrupt #61
139 ppca_irq_ppca_62 (CPUSS) — PPCA interrupt #62
140 ppca_irq_ppca_63 (CPUSS) — PPCA interrupt #63
141 svgs_interrupt (CPUSS)
142 mxaes_mxaes_level_int (CPUSS) — mxaes

## Licence text in the file
(c) (2016-2025), Cypress Semiconductor Corporation (an Infineon company) or an affiliate of Cypress Semiconductor Corporation. . SPDX-License-Identifier: Apache-2.0 . Licensed under the Apache License, Version 2.0 (the "License"); you may not use this file except in compliance with the License. You may obtain a copy of the License at http://www.apache.org/licenses/LICENSE-2.0 . Unless required by applicable law or agreed to in writing, software distributed under the License is distributed on an "AS IS" BASIS, WITHOUT WARRANTIES OR CONDITIONS OF ANY KIND, either express or implied. See the License for the specific language governing permissions and limitations under the License.
